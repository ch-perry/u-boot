## drivers/firmware/rpmi/Kconfig
```kconfig
config RPMI_FIRMWARE
	bool "Enable RPMI support"
	depends on RISCV || SANDBOX
	depends on DM && OF_CONTROL
	select FIRMWARE
	help
	  RISC-V Platform Management Interface (RPMI) defines an OS-agnostic
	  protocol for communication between an Application Processor (AP) and a
	  platform microcontroller (PuC). The RPMI specification is available
	  at: https://github.com/riscv-non-isa/riscv-rpmi

config RPMI_SBI_MPXY
	bool "RPMI over SBI MPXY transport"
	depends on RPMI_FIRMWARE && SBI
	help
	  Enable support for transport of RPMI messages over the message proxy
	  (MPXY) extension of the supervisor binary interface (SBI). The
	  specification for the MPXY extension is available at:
	  https://github.com/riscv-non-isa/riscv-sbi-doc (chapter 20)

config CMD_MPXY
	bool "mpxy command"
	depends on RPMI_SBI_MPXY
	help
	  Enable the 'mpxy' U-Boot command for listing MPXY channels,
	  reading/writing arbitrary channel attributes and sending raw messages.

config RPMI_SHMEM
	bool "RPMI over shared memory transport"
	depends on RPMI_FIRMWARE
	help
	  Enable support for transport of RPMI messages over shared memory as
	  described in chapter 2 of the RPMI specification, available at:
	  https://github.com/riscv-non-isa/riscv-rpmi
```
